## boards/arm/flickpad/Kconfig.defconfig
```kconfig
if BOARD_FLICKPAD

config ZMK_KEYBOARD_NAME
    default "flickpad"

config BT_CTLR
    default BT

endif # BOARD_FLICKPAD
```

## boards/arm/flickpad/flickpad_defconfig
```kconfig
CONFIG_SOC_SERIES_NRF52X=y
CONFIG_SOC_NRF52840_QIAA=y
CONFIG_BOARD_FLICKPAD=y

# enable MPU
CONFIG_ARM_MPU=y

# enable GPIO
CONFIG_GPIO=y

CONFIG_MPU_ALLOW_FLASH_WRITE=y
CONFIG_NVS=y
CONFIG_SETTINGS_NVS=y
CONFIG_FLASH=y
CONFIG_FLASH_PAGE_LAYOUT=y
CONFIG_FLASH_MAP=y

CONFIG_ZMK_BLE=y

CONFIG_ZMK_RTT_LOGGING=y
CONFIG_LOG_PROCESS_THREAD_STARTUP_DELAY_MS=8000
CONFIG_HW_STACK_PROTECTION=y
CONFIG_MAIN_STACK_SIZE=4096
CONFIG_ZMK_BLE_THREAD_STACK_SIZE=2048
```
